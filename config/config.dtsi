#define ZMK_POINTING_DEFAULT_MOVE_VAL 6000
#define ZMK_POINTING_DEFAULT_SCRL_VAL 80
#include <dt-bindings/zmk/pointing.h>

&mmv {
    time-to-max-speed-ms = <80>;
    acceleration-exponent = <3>;
};

&msc {
    time-to-max-speed-ms = <60>;
    acceleration-exponent = <4>;
};
